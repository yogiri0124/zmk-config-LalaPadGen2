#include <dt-bindings/zmk/pointing.h>

/ {
    // マウスボタンの押しっぱなし切り替え（zmk,behavior-mouse-button-toggle）が、切り替えの依頼を
    // 入力イベントの列に並べるために使う入力デバイス（クリックと同じ列で、操作した順に処理するため）。
    // behavior のインスタンス（button = <LCLK> など）は keymap で定義する
    mouse_lock_input: mouse_lock_input {
        compatible = "zmk,mouse-button-lock-input";
    };
};
