#include <dt-bindings/kana/kana.h>

/ {
    behaviors {
        // &kana_key（zmk,behavior-kana）・&kana_sw（zmk,behavior-kana-mode）・記号のキー（zmk,behavior-kana-seq）は
        // keymap 側で定義する
        // （Keymap Editor が keymap ファイル内の定義しか認識しないため）。
        // 例: kana_key: kana_key { compatible = "zmk,behavior-kana"; #binding-cells = <1>; };
        //     kana_sw: kana_sw { compatible = "zmk,behavior-kana-mode"; #binding-cells = <1>; layer = <かな単打面の番号>;
        //                        sub-layers = <親指シフト面などの番号>; };

        // 内部用（keymap には書かない）: 送信キューの処理完了の合図。C から参照するので omit しない。
        // ZMK Studio の一覧には出るので、内部用であることを表示名で示す（引数の情報を持たないので Studio からは
        // 割り当てられない。keymap に &kana_sync 0 と直接書いて押しても何もしない）
        kana_sync: kana_sync {
            compatible = "zmk,behavior-kana-sync";
            display-name = "内部用（割り当てない）";
            #binding-cells = <1>;
        };
    };
};
