## lalapad/dts/bindings/input/zmk,mouse-button-lock-input.yaml
```yaml
# マウスボタンの押しっぱなし切り替え（zmk,behavior-mouse-button-toggle）が、切り替えの依頼（INPUT_EV_MSC）を
# 入力イベントの列に並べるための共通の入力デバイス（クリックと同じ列で、操作した順に処理するため）。

description: Shared input device that queues mouse button toggle requests

compatible: "zmk,mouse-button-lock-input"
```

## lalapad/dts/bindings/input_processors/zmk,input-processor-auto-mouse-layer.yaml
```yaml
# オートマウスレイヤーの入力処理。リスナーの入力処理に <&zip_auto_mouse_layer> のように入れ、有効にするレイヤーと
# 解除までの時間はプロパティ（layer・timeout-ms）で指定する。カーソル移動・スクロールで有効にする
# （タップ・ジェスチャーや、触れただけでは有効にしない）。
# マウスレイヤーで &trans 以外（&none を含む）のキーと excluded-positions のキーは、押しても解除せず、離してから時間を数え直す
# （マウスレイヤーより上の有効なレイヤーに &trans 以外があるキーは、そちらが働くので除く）。
# それ以外のキーを押すとすぐに解除する（&trans のキーは下のレイヤーのキーとして入力される）。

description: Input processor that temporarily enables a mouse layer and keeps it while mouse keys are used

compatible: "zmk,input-processor-auto-mouse-layer"

include: ip_zero_param.yaml

properties:
  layer:
    type: int
    required: true
    description: 有効にするレイヤーの番号（keymap の宣言順）
  timeout-ms:
    type: int
    default: 0
    description: 操作が止まって（指とマウス操作のキーを離して）から解除するまでの時間（ms）。0 なら時間では解除しない
  require-prior-idle-ms:
    type: int
    default: 0
    description: 直前のキー入力（キーコードの押下と、トラックパッド由来でない位置の押下）からこの時間（ms）以内のトラックパッド操作では有効にしない。Alt コードを送っている間も有効にしない
  excluded-layers:
    type: array
    default: []
    description: >
      これらのレイヤーが有効な間は、マウスレイヤーを新しく有効にしない（数字・記号レイヤーなど、
      トラックパッドを触ってもマウスレイヤーにしたくないレイヤーを書く）
  excluded-positions:
    type: array
    default: []
    description: マウスレイヤーで &trans でも、マウス操作として扱うキー位置（修飾キー、トラックパッド由来の位置など）
  passive-positions:
    type: array
    default: []
    description: >
      マウスレイヤーに割り当てがあっても、マウス操作として扱わないキー位置。押しても解除せず、時間切れも延ばさない
      （マウスレイヤーで &trans など、ほかのレイヤーのキーが働くときは、ほかのキーと同じく押すと解除する）
  touch-devices:
    type: phandles
    description: INPUT_BTN_TOUCH（触れている=1／離れた=0）を送る入力デバイス。触れている間はレイヤーを時間切れにしない
  touch-stale-ms:
    type: int
    default: 30000
    description: 触れている間にこの時間（ms）そのデバイスから何も届かなければ、離れたとみなす（「離れた」の取りこぼし対策。0 で無効）
```

## lalapad/dts/bindings/input_processors/zmk,input-processor-tp-keys.yaml
```yaml
# トラックパッドをキー操作に変える入力処理。zmk,behavior-tp-keys・zmk,behavior-tp-stroke のキーを押している間だけ、
# トラックパッドの動きをキーの入力に変え、タップ・ジェスチャーを捨てる（押していない間は何もせず通す）。
# リスナーの入力処理の並びの先頭（タップ・ジェスチャーをキー位置に変える処理、速度の調整、
# オートマウスレイヤーより前）に入れる。INPUT_BTN_TOUCH はここで止める（リスナーは使わない）。

description: Input processor that turns trackpad movement into behaviors while a tp-keys / tp-stroke key is held

compatible: "zmk,input-processor-tp-keys"

include: ip_zero_param.yaml
```

## lalapad/dts/bindings/misc/lalapad,layer-ids.yaml
```yaml
# レイヤーの見分けの番号（キーマップのエディタ Noxrix が管理する）。
# keymap のレイヤー（zmk,keymap の子ノード）と同じ順番に、レイヤーごとの番号を 1 つずつ並べる。
# 番号はレイヤーを作ったときに決め、名前を変えても、並べ替えても変えない（ほかのレイヤーと重ねない。1〜255）。
# ファームウェアは、この番号で
#   - ZMK Studio で保存した変更（キー・レイヤーの名前・順番）を、キーマップでレイヤーを並べ替え・足し・消ししても、
#     同じレイヤーに付いていくよう付け替える（lalapad/src/layer_ids.c）
#   - キー位置の送信（docs/key-stream.md の 0x86・0x06）で、アプリにレイヤー ID ごとの番号を知らせる
# keymap の子ノードの数（ZMK Studio が有効なら無効のものも含めたすべて）と同じ数でないとビルドが止まる。

description: Stable identities of the keymap layers, in the keymap's layer order

compatible: "lalapad,layer-ids"

properties:
  ids:
    type: array
    required: true
    description: One number (1-255, unique) per keymap layer, in declaration order
```
