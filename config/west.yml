## config/west.yml
```yaml
manifest:
  remotes:
    - name: zmkfirmware
      url-base: https://github.com/zmkfirmware
    - name: ShiniNet
      url-base: https://github.com/ShiniNet/
    - name: caksoylar
      url-base: https://github.com/caksoylar
    - name: kot149
      url-base: https://github.com/kot149
    - name: yogiri0124
      url-base: https://github.com/yogiri0124
  projects:
    - name: zmk
      remote: zmkfirmware
      revision: v0.3.0
      import: app/west.yml
    - name: zmk-driver-iqs9151
      remote: yogiri0124
      revision: v1.0.0-lalapad-touch.1
    - name: zmk-easy-charge-indicator
      remote: ShiniNet
      revision: v1.0.0
    - name: zmk-rgbled-widget
      remote: caksoylar
      revision: v0.3
    - name: zmk-scroll-snap
      remote: kot149
      # v1 はタグではなく更新され続けるブランチなので、ビルドが変わらないようコミットで固定する（2026-10-22 時点の v1）
      revision: 2feeb988f5b5a3c2b5e09ba6472e86e6902463a2
  self:
    path: config
```

## kana/Kconfig
```kconfig
config ZMK_BEHAVIOR_KANA
    bool "Kana romaji output behaviors (&kana_key, &kana_sw)"
    default y
    depends on DT_HAS_ZMK_BEHAVIOR_KANA_ENABLED || DT_HAS_ZMK_BEHAVIOR_KANA_MODE_ENABLED

config ZMK_BEHAVIOR_MOUSE_BUTTON_TOGGLE
    bool "Mouse button toggle behavior (zmk,behavior-mouse-button-toggle)"
    default y
    depends on (DT_HAS_ZMK_BEHAVIOR_MOUSE_BUTTON_TOGGLE_ENABLED || DT_HAS_ZMK_MOUSE_BUTTON_LOCK_INPUT_ENABLED) && ZMK_POINTING

config ZMK_CURSOR_SLOW
    bool "Cursor slow mode (zmk,behavior-cursor-slow, zmk,input-processor-cursor-slow)"
    default y
    depends on DT_HAS_ZMK_BEHAVIOR_CURSOR_SLOW_ENABLED || DT_HAS_ZMK_INPUT_PROCESSOR_CURSOR_SLOW_ENABLED

config ZMK_BEHAVIOR_KEY_LOCK
    bool "Key lock behavior (zmk,behavior-key-lock)"
    default y
    depends on DT_HAS_ZMK_BEHAVIOR_KEY_LOCK_ENABLED

config ZMK_AUTO_MOUSE_LAYER
    bool "Auto mouse layer input processor (zmk,input-processor-auto-mouse-layer)"
    default y
    depends on DT_HAS_ZMK_INPUT_PROCESSOR_AUTO_MOUSE_LAYER_ENABLED && ZMK_POINTING

config ZMK_BEHAVIOR_ALT_CODE
    bool "Windows Alt code behavior (zmk,behavior-alt-code)"
    default y
    depends on DT_HAS_ZMK_BEHAVIOR_ALT_CODE_ENABLED

config ZMK_SCROLL_SNAP_GATE
    bool "Scroll snap hold (zmk,behavior-scroll-snap-hold, zmk,input-processor-scroll-snap-gate)"
    default y
    depends on (DT_HAS_ZMK_BEHAVIOR_SCROLL_SNAP_HOLD_ENABLED || DT_HAS_ZMK_INPUT_PROCESSOR_SCROLL_SNAP_GATE_ENABLED) && ZMK_POINTING
```

## kana/dts/bindings/behaviors/zmk,behavior-cursor-slow.yaml
```yaml
# カーソル低速のオン・オフ behavior（引数なし）。mode で動作を指定する。
# 低速の間は zmk,input-processor-cursor-slow がカーソル移動を遅くする。

description: Cursor slow mode behavior

compatible: "zmk,behavior-cursor-slow"

include: zero_param.yaml

properties:
  mode:
    type: int
    required: true
    description: CURSOR_SLOW_HOLD（押している間）/ CURSOR_SLOW_TOGGLE（入れ切り）/ CURSOR_SLOW_ONESHOT（次のキーまで）
```

## kana/dts/bindings/behaviors/zmk,behavior-kana-mode.yaml
```yaml
# かな配列モードのオン／オフ behavior (&kana_mode KANA_MODE_ON / KANA_MODE_OFF)。

description: Kana input mode on/off behavior

compatible: "zmk,behavior-kana-mode"

include: one_param.yaml

properties:
  layer:
    type: int
    required: true
    description: かな単打面のレイヤー番号（keymap で &kana_mode { layer = <...>; }; と指定する）
  tap-ms:
    type: int
    default: 10
    description: IME キーを押してから離すまでの時間 (ms)
  wait-ms:
    type: int
    default: 10
    description: IME キーを離してから次の送信までの時間 (ms)
```

## kana/dts/bindings/behaviors/zmk,behavior-kana-seq.yaml
```yaml
# 決まった打鍵の列を送る behavior（引数なし）。送る打鍵は keys に書く。
# ZMK 標準のマクロと違い、&kana_key と同じ送り方をする（かな配列モードの解除処理中は捨てる、
# 送信キューが満杯なら残りを打ち切る、かなと同じキューに並ぶので追い越さない）。
# かな配列モードでないときも使える。

description: Fixed key sequence sent through the kana output queue

compatible: "zmk,behavior-kana-seq"

include: zero_param.yaml

properties:
  keys:
    type: array
    required: true
    description: 順に1回ずつタップするキー（dt-bindings/zmk/keys.h の名前。LS(N9) のような修飾つきも可）
  ime-on:
    type: boolean
    description: >
      かな配列モードでないときも、打鍵の前に IME オン (LANGUAGE_1) を毎回送る
      （IME のローマ字テーブルを前提にした記号用）
  tap-ms:
    type: int
    default: 5
    description: 1キーを押してから離すまでの時間 (ms)
  wait-ms:
    type: int
    default: 5
    description: キーを離してから次のキーを押すまでの時間 (ms)
  ime-resync-ms:
    type: int
    default: 1000
    description: >
      かな配列モード中、かな・記号をこの時間 (ms) 以上打っていなかったら、打鍵の前に IME オン (LANGUAGE_1) を送る
      （&kana_key の ime-resync-ms と同じ働き）。0 で無効
```

## kana/dts/bindings/behaviors/zmk,behavior-kana-sync.yaml
```yaml
# かな入力モジュール内部用の behavior。behavior queue の処理完了の合図に使う（keymap には書かない）。

description: Kana input internal queue sync marker

compatible: "zmk,behavior-kana-sync"

include: one_param.yaml
```

## kana/dts/bindings/behaviors/zmk,behavior-kana.yaml
```yaml
# かな入力 behavior (&kana)。文字 ID (dt-bindings/kana/kana.h) を受け取り、ローマ字のキー列を送る。

description: Kana romaji output behavior

compatible: "zmk,behavior-kana"

include: one_param.yaml

properties:
  tap-ms:
    type: int
    default: 5
    description: 1キーを押してから離すまでの時間 (ms)
  wait-ms:
    type: int
    default: 5
    description: キーを離してから次のキーを押すまでの時間 (ms)
  ime-resync-ms:
    type: int
    default: 1000
    description: >
      かな・記号をこの時間 (ms) 以上打っていなかった後の最初の1文字の前に IME オン (LANGUAGE_1) を送り、
      IME がオフになっていてもローマ字のまま入力されないようにする。0 で無効
```

## kana/dts/bindings/behaviors/zmk,behavior-mouse-button-toggle.yaml
```yaml
# マウスボタンの押しっぱなし切り替え behavior（引数なし）。button で対象のボタンを指定する。
# 押すたびに押しっぱなし／解除。押しっぱなし中に同じボタンのクリックが来ても解除する。

description: Mouse button toggle (drag lock) behavior

compatible: "zmk,behavior-mouse-button-toggle"

include: zero_param.yaml

properties:
  button:
    type: int
    required: true
    description: 対象のマウスボタン（LCLK / MCLK / RCLK / MB4 / MB5）
```

## kana/dts/bindings/input_processors/zmk,input-processor-auto-mouse-layer.yaml
```yaml
# オートマウスレイヤーの入力処理。<&zip_auto_mouse_layer レイヤー番号 解除までのms> のように使う。
# マウスレイヤーで何か割り当ててあるキーと excluded-positions のキーは、押しても解除せず、離してから時間を数え直す。
# それ以外のキーを押すとすぐに解除する。

description: Input processor that temporarily enables a mouse layer and keeps it while mouse keys are used

compatible: "zmk,input-processor-auto-mouse-layer"

include: ip_two_param.yaml

properties:
  require-prior-idle-ms:
    type: int
    default: 0
    description: 直前のキー入力からこの時間（ms）以内のトラックパッド操作では有効にしない
  excluded-positions:
    type: array
    default: []
    description: マウスレイヤーで割り当てがなくても（&trans でも）マウス操作として扱うキー位置（修飾キー、トラックパッド由来の位置など）
  touch-devices:
    type: phandles
    description: INPUT_BTN_TOUCH（触れている=1／離れた=0）を送る入力デバイス。触れている間はレイヤーを時間切れにしない
  touch-stale-ms:
    type: int
    default: 30000
    description: 触れている間にこの時間（ms）そのデバイスから何も届かなければ、離れたとみなす（「離れた」の取りこぼし対策。0 で無効）
```

## kana/dts/bindings/input_processors/zmk,input-processor-scroll-snap-gate.yaml
```yaml
# スクロールスナップの入り口の入力処理。zmk,behavior-scroll-snap-hold のキーを押している間だけ、
# processor で指定した入力処理（zmk,input-processor-scroll-snap）にイベントを渡す。

description: Input processor that forwards events to another processor only while scroll snap is held

compatible: "zmk,input-processor-scroll-snap-gate"

include: ip_zero_param.yaml

properties:
  processor:
    type: phandle
    required: true
    description: 押している間だけイベントを渡す入力処理（引数なしのもの。例 &zip_scroll_snap_R）
```

## kana/dts/bindings/zmk,mouse-button-lock-input.yaml
```yaml
# マウスボタンの押しっぱなし切り替え（zmk,behavior-mouse-button-toggle）が INPUT_BTN_* を出す共通の入力デバイス。

description: Shared input device for mouse button toggle behaviors

compatible: "zmk,mouse-button-lock-input"
```

## lalapad/Kconfig
```kconfig
# このモジュールの behavior と入力処理は、keymap を処理する側（central。分割でなければ本体）でだけ使う
config LALAPAD_CENTRAL
    def_bool !ZMK_SPLIT || ZMK_SPLIT_ROLE_CENTRAL

config ZMK_BEHAVIOR_KANA
    bool "Kana romaji output behaviors (&kana_key, &kana_sw, zmk,behavior-kana-seq)"
    default y
    depends on LALAPAD_CENTRAL && (DT_HAS_ZMK_BEHAVIOR_KANA_ENABLED || DT_HAS_ZMK_BEHAVIOR_KANA_MODE_ENABLED || DT_HAS_ZMK_BEHAVIOR_KANA_SEQ_ENABLED)

config ZMK_BEHAVIOR_MOUSE_BUTTON_TOGGLE
    bool "Mouse button toggle behavior (zmk,behavior-mouse-button-toggle)"
    default y
    depends on LALAPAD_CENTRAL && ((DT_HAS_ZMK_BEHAVIOR_MOUSE_BUTTON_TOGGLE_ENABLED || DT_HAS_ZMK_MOUSE_BUTTON_LOCK_INPUT_ENABLED) && ZMK_POINTING)

config ZMK_CURSOR_SLOW
    bool "Cursor slow mode (zmk,behavior-cursor-slow, zmk,input-processor-cursor-slow)"
    default y
    depends on LALAPAD_CENTRAL && ((DT_HAS_ZMK_BEHAVIOR_CURSOR_SLOW_ENABLED || DT_HAS_ZMK_INPUT_PROCESSOR_CURSOR_SLOW_ENABLED) && ZMK_POINTING)

config ZMK_BEHAVIOR_KEY_LOCK
    bool "Key lock behavior (zmk,behavior-key-lock)"
    default y
    depends on LALAPAD_CENTRAL && (DT_HAS_ZMK_BEHAVIOR_KEY_LOCK_ENABLED)

config ZMK_AUTO_MOUSE_LAYER
    bool "Auto mouse layer input processor (zmk,input-processor-auto-mouse-layer)"
    default y
    depends on LALAPAD_CENTRAL && (DT_HAS_ZMK_INPUT_PROCESSOR_AUTO_MOUSE_LAYER_ENABLED && ZMK_POINTING)

config ZMK_BEHAVIOR_LAYER_LOCK
    bool "Layer lock behavior (zmk,behavior-layer-lock)"
    default y
    depends on LALAPAD_CENTRAL && DT_HAS_ZMK_BEHAVIOR_LAYER_LOCK_ENABLED

config ZMK_BEHAVIOR_WORD_LAYER
    bool "Word layer behavior (zmk,behavior-word-layer)"
    default y
    depends on LALAPAD_CENTRAL && DT_HAS_ZMK_BEHAVIOR_WORD_LAYER_ENABLED

config ZMK_BEHAVIOR_ALT_TAB
    bool "Alt+Tab window switcher behavior (zmk,behavior-alt-tab)"
    default y
    depends on LALAPAD_CENTRAL && (DT_HAS_ZMK_BEHAVIOR_ALT_TAB_ENABLED)

config ZMK_BEHAVIOR_ALT_CODE
    bool "Windows Alt code behavior (zmk,behavior-alt-code)"
    default y
    depends on LALAPAD_CENTRAL && (DT_HAS_ZMK_BEHAVIOR_ALT_CODE_ENABLED)

config ZMK_TP_KEYS
    bool "Trackpad to keys (zmk,behavior-tp-keys, zmk,behavior-tp-stroke, zmk,input-processor-tp-keys)"
    default y
    depends on LALAPAD_CENTRAL && ((DT_HAS_ZMK_BEHAVIOR_TP_KEYS_ENABLED || DT_HAS_ZMK_BEHAVIOR_TP_STROKE_ENABLED || DT_HAS_ZMK_INPUT_PROCESSOR_TP_KEYS_ENABLED) && ZMK_POINTING)

config ZMK_SCROLL_SNAP_GATE
    bool "Scroll snap hold (zmk,behavior-scroll-snap-hold, zmk,input-processor-scroll-snap-gate)"
    default y
    depends on LALAPAD_CENTRAL && ((DT_HAS_ZMK_BEHAVIOR_SCROLL_SNAP_HOLD_ENABLED || DT_HAS_ZMK_INPUT_PROCESSOR_SCROLL_SNAP_GATE_ENABLED) && ZMK_POINTING)

config ZMK_POSITION_RELAY
    bool "Process position events raised outside the system work queue on the system work queue"
    default y
    depends on LALAPAD_CENTRAL
    help
      トラックパッドのタップ・ジェスチャーなど、入力スレッドから出たキー位置の出来事を預かり、キーマップと
      behavior の処理をシステムワークキューで行う（lalapad/src/position_relay.c）。

config ZMK_KEY_STREAM
    bool "Send key position events to the host over a vendor raw HID (USB and BLE)"
    depends on LALAPAD_CENTRAL
    depends on ZMK_USB || ZMK_BLE
    help
      キーが押された／離されたときに、その位置番号を raw HID で PC のアプリに送る（lalapad/src/key_stream.c）。
      アプリから「開始」を受けている間だけ送る。USB で使うときは CONFIG_USB_HID_DEVICE_COUNT=2 も必要。

if ZMK_KEY_STREAM

config ZMK_KEY_STREAM_USB
    bool "Key stream over USB (a second USB HID device)"
    default y
    depends on ZMK_USB

config ZMK_KEY_STREAM_BLE
    bool "Key stream over BLE (a second HID over GATT service)"
    default y
    depends on ZMK_BLE

endif
```

## lalapad/dts/bindings/behaviors/zmk,behavior-auto-mouse-lock.yaml
```yaml
# オートマウスレイヤーを固定する behavior（引数なし）。押すたびに固定・固定をやめるを切り替える。
# 固定している間は、時間切れでも、マウスレイヤーで &trans のキーなどを押しても解除しない。

description: Toggle a lock that keeps the auto mouse layer active

compatible: "zmk,behavior-auto-mouse-lock"

include: zero_param.yaml
```

## lalapad/dts/bindings/behaviors/zmk,behavior-kana-mode.yaml
```yaml
# かな配列モードのオン／オフ behavior (&kana_sw KANA_SW_ON / KANA_SW_OFF)。

description: Kana input mode on/off behavior

compatible: "zmk,behavior-kana-mode"

include: one_param.yaml

properties:
  layer:
    type: int
    required: true
    description: かな単打面のレイヤー番号（keymap で &kana_sw { layer = <...>; }; と指定する）
  sub-layers:
    type: array
    default: []
    description: >
      かなモードを抜けるときに、かな単打面といっしょに消すレイヤーの番号（親指シフト面など。&mo で入るレイヤー）。
      親指シフトのキーを押したままかなモードを抜けても、シフト面が残らないようにする
  tap-ms:
    type: int
    default: 5
    description: IME キーを押してから離すまでの時間 (ms)
  wait-ms:
    type: int
    default: 5
    description: IME キーを離してから次の送信までの時間 (ms)
```

## lalapad/dts/bindings/behaviors/zmk,behavior-kana.yaml
```yaml
# かな入力 behavior (&kana_key)。文字 ID (dt-bindings/kana/kana.h) を受け取り、ローマ字のキー列を送る。

# マクロ（zmk,behavior-macro）の中には置かない（マクロを送る behavior queue の処理の中から、さらに同じキューに
# 並べることになり、待ち時間が効かず、処理が入れ子になってスタックを使う）。
description: Kana romaji output behavior

compatible: "zmk,behavior-kana"

include: one_param.yaml

properties:
  tap-ms:
    type: int
    default: 5
    description: 1キーを押してから離すまでの時間 (ms)
  wait-ms:
    type: int
    default: 5
    description: キーを離してから次のキーを押すまでの時間 (ms)
  ime-resync-ms:
    type: int
    default: 1000
    description: >
      かな・記号をこの時間 (ms) 以上打っていなかった後の最初の1文字の前に IME オン (LANGUAGE_1) を送り、
      IME がオフになっていてもローマ字のまま入力されないようにする（接続先の切り替えやトラックパッドの
      クリック・ジェスチャーの後の最初の1文字の前にも送る）。0 で無効（かな配列モードに入るときだけ送る）
```

## lalapad/dts/bindings/behaviors/zmk,behavior-kanji.yaml
```yaml
# 漢字入力 behavior (&kanji_key)。漢字の番号 (dt-bindings/kana/kanji.h の KJ_…。1〜675) を受け取り、
# その番号の符号（「;」＋英字 2 文字）を送る。符号を漢字に変えるのは PC 側の IME のローマ字テーブル
# （docs/google-ime/kanji.tsv から docs/tools/gen_kanji.py で作る）。
# &kana_key と同じ送信キューで送り、かな配列モードでないときは捨てる。

# マクロ（zmk,behavior-macro）の中には置かない（マクロを送る behavior queue の処理の中から、さらに同じキューに
# 並べることになり、待ち時間が効かず、処理が入れ子になってスタックを使う）。
description: Kanji code output behavior (converted by the host IME romaji table)

compatible: "zmk,behavior-kanji"

include: one_param.yaml

properties:
  tap-ms:
    type: int
    default: 5
    description: 1キーを押してから離すまでの時間 (ms)
  wait-ms:
    type: int
    default: 5
    description: キーを離してから次のキーを押すまでの時間 (ms)
  ime-resync-ms:
    type: int
    default: 1000
    description: >
      かな・記号・漢字をこの時間 (ms) 以上打っていなかった後の最初の 1 文字の前に IME オン (LANGUAGE_1) を送る
      （&kana_key の ime-resync-ms と同じ働き）。0 で無効
  chord-ms:
    type: int
    default: 40
    description: >
      かなキーの同時押しで漢字を出すとき（docs/google-ime/kanji.tsv の「同時押し」の列）、同時に押したとみなす時間 (ms)。
      最初のキーを押してから、この時間のうちに残りのキーを押すと同時押し。0 で同時押しを使わない
      （最初の kanji_key の値を使う）。同時押しに使うかなキーは、単独で押したときもこの時間だけ待ってから送る
```

## lalapad/dts/bindings/behaviors/zmk,behavior-key-lock.yaml
```yaml
# キーの押しっぱなし切り替え behavior（引数なし）。keycode で対象のキーを指定する。
# 押すたびに押しっぱなし／解除。押しっぱなしかどうかはインスタンスごとに自分で覚える（PC 側の状態は見ない）。

description: Key lock (toggle) behavior with a fixed keycode

compatible: "zmk,behavior-key-lock"

include: zero_param.yaml

properties:
  keycode:
    type: int
    required: true
    description: 対象のキー（LCTRL / LSHIFT / LALT / LGUI など）
```

## lalapad/dts/bindings/behaviors/zmk,behavior-layer-lock.yaml
```yaml
# レイヤーを固定する behavior（引数なし。QMK の Layer Lock）。押すと、このキーを置いたレイヤーを固定する
# （&mo のキーを離しても、オートマウスレイヤーの時間切れでも切れない）。もう一度押すと固定をやめて解除する
# （オートマウスレイヤーなら、ふだんどおり時間を数え直す）。Default と、conditional_layers が有効・解除する
# レイヤー（then-layer）は固定しない。かなのレイヤーの固定は、かなモードを抜けるとやめる（kana_output.c が
# layer_lock_forget を呼ぶ）。
# 固定する前からほかの操作（&tog・かなモードなど）で有効だったレイヤーも、固定をやめると解除する（QMK と同じ。
# かなのレイヤーなら、かなモードも終わる。IME はオンのまま）。
# combos・マクロ・hold-tap（&mt など）の中から押すと、ZMK v0.3.0 はレイヤーを Default として渡すので、何もしない
# （キーマップのレイヤーに直接置く）。

description: Lock the layer this key is on (like QMK Layer Lock)

compatible: "zmk,behavior-layer-lock"

include: zero_param.yaml
```

## lalapad/dts/bindings/behaviors/zmk,behavior-scroll-snap-hold.yaml
```yaml
# スクロールスナップを押している間だけオンにする behavior（引数なし）。
# オンの間、zmk,input-processor-scroll-snap-gate がスクロールスナップの入力処理にイベントを渡す。

description: Hold to enable scroll snap (axis lock) without using a layer

compatible: "zmk,behavior-scroll-snap-hold"

include: zero_param.yaml
```
