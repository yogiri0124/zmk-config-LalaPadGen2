## lalapad/dts/bindings/behaviors/zmk,behavior-tp-keys.yaml
```yaml
# トラックパッドの動きをキーに変える behavior（引数なし）。押している間だけ、指を動かした量 cursor-step
# （2 本指は scroll-step）ごとに、その向きの binding を 1 回送る。押している間のタップ・ジェスチャーは捨てる。
# 送るものは、直下の bindings（どのレイヤーでも使う既定）と、子ノード（表。layers に書いたレイヤーで使う）に書く。
# 動き始めの向きで縦か横かを決め、指が触れ直す・離れるか、モードのキーを押す・離すまで変えない。
# 実際に動きを変えるのは、トラックパッドのリスナーに入れた zmk,input-processor-tp-keys。

description: Hold to turn trackpad movement into key presses (arrow keys, dials)

compatible: "zmk,behavior-tp-keys"

include: zero_param.yaml

properties:
  bindings:
    type: phandle-array
    description: >
      どのレイヤーでも使う既定（左右共通）。8 つ: 1 本指を上・下・左・右へ動かしたとき、2 本指を上・下・左・右へ
      動かしたとき（2 本指も指を動かした向き。スクロールの向きではない）。1 本指（または 2 本指）の 4 つがすべて
      &trans（表・既定をたどった結果）なら、そちらは変えずにカーソル（スクロール）のまま通す
  left-bindings:
    type: phandle-array
    # 引数の数は、bindings と同じく、割り当てる behavior の #binding-cells で決める
    specifier-space: binding
    description: 左のトラックパッドで出すもの（そちらでは bindings の代わりに使う）
  right-bindings:
    type: phandle-array
    specifier-space: binding
    description: 右のトラックパッド（分割の通信で届くもの）で出すもの（そちらでは bindings の代わりに使う）
  cursor-step:
    type: int
    default: 150
    description: 1 本指で 1 回送るのに必要な動きの量（トラックパッドの生の値。速度の設定には影響されない。1〜65535）
  scroll-step:
    type: int
    default: 150
    description: 2 本指で 1 回送るのに必要な動きの量（トラックパッドの生の値。2 本指の中心の動き。1〜65535）
  tap-ms:
    type: int
    default: 10
    description: 押してから離すまで、離してから次を押すまでの時間 (ms。0〜65535)

child-binding:
  description: >
    レイヤーごとの表。このキーを押したときに有効なレイヤーを上から見て、そのレイヤーを layers に書いた表を使う
    （表のないレイヤーは素通り）。表の中の &trans は、その下のレイヤーの表、最後に直下の既定を見る。
    書き方は直下と同じ（bindings は左右共通、left-bindings・right-bindings は左右別。bindings がないときは両方要る）。
    表から送るものは、keymap のキーと同じく、その表のレイヤーで送る（そのレイヤーを解除すると、まだ送っていない分は
    捨て、&swap_next などはそこで終わる）
  properties:
    layers:
      type: array
      required: true
      description: この表を使うレイヤー（keymap の宣言順の番号。#define の名前を書ける。同じレイヤーを複数の表に書いたときは先の表）
    bindings:
      type: phandle-array
      description: 左右共通の出すもの
    left-bindings:
      type: phandle-array
      # 引数の数は、bindings と同じく、割り当てる behavior の #binding-cells で決める
      specifier-space: binding
      description: 左のトラックパッドで出すもの（そちらでは bindings の代わりに使う）
    right-bindings:
      type: phandle-array
      specifier-space: binding
      description: 右のトラックパッド（分割の通信で届くもの）で出すもの（そちらでは bindings の代わりに使う）
```

## lalapad/dts/bindings/behaviors/zmk,behavior-tp-stroke.yaml
```yaml
# トラックパッドの一筆書きでキーを送る behavior（引数なし）。押している間に 1 本指で描いた向きの並びを覚え、
# 指を離したとき（または先にこのキーを離したとき）に、並びが一致する binding を 1 回送る。
# 送るものは、直下の bindings（どのレイヤーでも使う既定）と、子ノード（表。layers に書いたレイヤーで使う）に書く。
# 押している間のタップ・ジェスチャーは捨てる。2 本指のスクロールはそのまま通す。
# 実際に動きを読むのは、トラックパッドのリスナーに入れた zmk,input-processor-tp-keys。

description: Hold and draw a stroke on the trackpad to send a binding

compatible: "zmk,behavior-tp-stroke"

include: zero_param.yaml

properties:
  strokes:
    type: array
    required: true
    description: >
      向きの並び（dt-bindings/lalapad/tp_keys.h の TP_STROKE1〜4 と TP_UP・TP_DOWN・TP_LEFT・TP_RIGHT。
      例 TP_STROKE2(TP_DOWN, TP_RIGHT)）。すべてのレイヤーで共通。bindings（表の bindings も）は、これと同じ数・同じ順番で書く。
      続けて同じ向きに動かしても 1 つの向きとして数えるので、同じ向きを続けて並べたもの
      （TP_STROKE2(TP_UP, TP_UP) など）は描けない。5 つ以上の向きを描いたときは、どれにも一致しない
  bindings:
    type: phandle-array
    description: どのレイヤーでも使う既定（左右共通）。strokes と同じ数・同じ順番で、その並びを描いたときに送るもの
  left-bindings:
    type: phandle-array
    # 引数の数は、bindings と同じく、割り当てる behavior の #binding-cells で決める
    specifier-space: binding
    description: 左のトラックパッドで出すもの（そちらでは bindings の代わりに使う）
  right-bindings:
    type: phandle-array
    specifier-space: binding
    description: 右のトラックパッド（分割の通信で届くもの）で出すもの（そちらでは bindings の代わりに使う）
  stroke-step:
    type: int
    default: 300
    description: 1 つの向きとみなす動きの量（トラックパッドの生の値。1〜65535）
  tap-ms:
    type: int
    default: 10
    description: 押してから離すまで、離してから次を押すまでの時間 (ms。0〜65535)

child-binding:
  description: >
    レイヤーごとの表。このキーを押したときに有効なレイヤーを上から見て、そのレイヤーを layers に書いた表を使う
    （表のないレイヤーは素通り）。表の中の &trans は、その下のレイヤーの表、最後に直下の既定を見る。
    書き方は直下と同じ（bindings は左右共通、left-bindings・right-bindings は左右別。bindings がないときは両方要る）。
    表から送るものは、keymap のキーと同じく、その表のレイヤーで送る（そのレイヤーを解除すると、まだ送っていない分は
    捨て、&swap_next などはそこで終わる）
  properties:
    layers:
      type: array
      required: true
      description: この表を使うレイヤー（keymap の宣言順の番号。#define の名前を書ける。同じレイヤーを複数の表に書いたときは先の表）
    bindings:
      type: phandle-array
      description: 左右共通の出すもの
    left-bindings:
      type: phandle-array
      # 引数の数は、bindings と同じく、割り当てる behavior の #binding-cells で決める
      specifier-space: binding
      description: 左のトラックパッドで出すもの（そちらでは bindings の代わりに使う）
    right-bindings:
      type: phandle-array
      specifier-space: binding
      description: 右のトラックパッド（分割の通信で届くもの）で出すもの（そちらでは bindings の代わりに使う）
```
