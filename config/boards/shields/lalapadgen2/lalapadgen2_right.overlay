#include "lalapadgen2.dtsi"

&default_transform {
    col-offset = <6>;
};

&kscan0 {
    col-gpios
        = <&xiao_d 0 GPIO_ACTIVE_HIGH>
        , <&xiao_d 1 GPIO_ACTIVE_HIGH>
        , <&xiao_d 2 GPIO_ACTIVE_HIGH>
        , <&xiao_d 3 GPIO_ACTIVE_HIGH>
        , <&gpio0 15 GPIO_ACTIVE_HIGH>
        , <&gpio0 19 GPIO_ACTIVE_HIGH>
        ;
};

// 右のトラックパッドの入力を、親機の左へ送る
&trackpad_split_R {
    status = "okay";
    device = <&iqs9151>;
};
