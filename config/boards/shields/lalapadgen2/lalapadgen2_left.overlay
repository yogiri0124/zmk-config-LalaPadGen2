#include "lalapadgen2.dtsi"

&kscan0 {
    col-gpios
        = <&gpio0 19 GPIO_ACTIVE_HIGH>
        , <&gpio0 15 GPIO_ACTIVE_HIGH>
        , <&xiao_d 3 GPIO_ACTIVE_HIGH>
        , <&xiao_d 2 GPIO_ACTIVE_HIGH>
        , <&xiao_d 1 GPIO_ACTIVE_HIGH>
        , <&xiao_d 0 GPIO_ACTIVE_HIGH>
        ;
};

&trackpad_listener_L {
    status = "okay";
    device = <&iqs9151>;
};
&trackpad_listener_R {
    status = "okay";
};

// オートマウスレイヤー: 左右のトラックパッドに触れている間は時間切れにしない（左 = このドライバ、右 = 子機からの中継）
&zip_auto_mouse_layer {
    touch-devices = <&iqs9151 &trackpad_split_R>;
};
