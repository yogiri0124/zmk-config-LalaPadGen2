#include <dt-bindings/zmk/pointing.h>

/ {
    behaviors {
        /omit-if-no-ref/ mbt: mouse_button_toggle {
            compatible = "zmk,behavior-mouse-button-toggle";
            #binding-cells = <1>;
            display-name = "Mouse Button Toggle";
        };
    };

    // &mbt が出す INPUT_BTN_* を HID のマウスボタンに反映する（ZMK の mkp_input_listener と同じ形）
    mbt_input_listener: mbt_input_listener {
        compatible = "zmk,input-listener";
        device = <&mbt>;
    };
};
